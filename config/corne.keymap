#include <behaviors.dtsi>
#include <behaviors/num_word.dtsi> // Requires auto-layer module.
#include <dt-bindings/zmk/keys.h>
#ifdef CONFIG_WIRELESS
#include <dt-bindings/zmk/bt.h>
#include <dt-bindings/zmk/outputs.h>
#define _BT_SEL_KEYS_                                                        \
&bt BT_SEL 0 &bt BT_SEL 1 &bt BT_SEL 2 &bt BT_SEL 3 &bt BT_CLR
#else
#define _BT_SEL_KEYS_ &trans &trans &trans &trans &trans
#endif

#include "zmk-helpers/key-labels/42.h"
#include "zmk-helpers/helper.h"

#define DEF 0
#define SYM 1
#define NAV 2
#define FN 3
#define NUM 4
#define SYS 5

#define XXX &none
#define ___ &trans
#define HYPER LS(LC(LA(LGUI)))

/* Global defaults */

#define QUICK_TAP_MS 175

&sk {
  release-after-ms = <900>;
  quick-release;
};

&sl { // Allow sticky mods to chord across sticky layers.
  ignore-modifiers;
};

&lt {
  flavor = "balanced";
  tapping-term-ms = <200>;
  quick-tap-ms = <QUICK_TAP_MS>;
};

/* Homerow mods */

#define KEYS_L LT0 LT1 LT2 LT3 LT4 LM0 LM1 LM2 LM3 LM4 LB0 LB1 LB2 LB3 LB4
#define KEYS_R RT0 RT1 RT2 RT3 RT4 RM0 RM1 RM2 RM3 RM4 RB0 RB1 RB2 RB3 RB4
#ifndef LH2
#define THUMBS LH1 LH0 RH0 RH1         // Thumbs on 34 keys.
#else
#define THUMBS LH2 LH1 LH0 RH0 RH1 RH2 // Thumbs on 36+ keys.
#endif

#define MAKE_HRM(NAME, HOLD, TAP, TRIGGER_POS)                                 \
ZMK_HOLD_TAP(NAME, bindings = <HOLD>, <TAP>; flavor = "balanced";            \
tapping-term-ms = <280>; quick-tap-ms = <QUICK_TAP_MS>;         \
require-prior-idle-ms = <150>; hold-trigger-on-release;         \
hold-trigger-key-positions = <TRIGGER_POS>;)

MAKE_HRM(hml, &kp, &kp, KEYS_R THUMBS) // Left-hand HRMs.
MAKE_HRM(hmr, &kp, &kp, KEYS_L THUMBS) // Right-hand HRMs.

/* Mouse emulation */
#include "mouse.dtsi"

/* Nav cluster */

// Trigger tap-action on all interrupts.
#define MT_CORE                                                                \
flavor = "tap-preferred";                                                    \
tapping-term-ms = <220>;                                                     \
quick-tap-ms = <220>;                                                        \
hold-trigger-key-positions = <0>;

&mt { MT_CORE };

#define NAV_LEFT  &mt HOME     LEFT  // Tap: left  | Long-tap: start of line.
#define NAV_RIGHT &mt END      RIGHT // Tap: right | Long-tap: end   of line.
#define NAV_UP    &mt LC(HOME) UP    // Tap: up    | Long-tap: start of doc.
#define NAV_DOWN  &mt LC(END)  DOWN  // Tap: down  | Long-tap: end   of doc.
#define NAV_BSPC  &mt LC(BSPC) BSPC  // Tap: bspc  | Long-tap: delete word bwd.
#define NAV_DEL   &mt LC(DEL)  DEL   // Tap: del   | Long-tap: delete word fwd.

// Tap: num-word | double-tap: sticky num-layer | Hold: num-layer.
#define SMART_NUM &smart_num NUM 0
ZMK_HOLD_TAP(smart_num, bindings = <&mo>, <&num_dance>; flavor = "balanced";
tapping-term-ms = <200>; quick-tap-ms = <QUICK_TAP_MS>;)
ZMK_TAP_DANCE(num_dance, bindings = <&num_word NUM>, <&sl NUM>;
tapping-term-ms = <200>;)

// Define mod-morph with a *single* mod trigger for less repetition.
#define SIMPLE_MORPH(NAME, MOD, BINDING1, BINDING2)                            \
ZMK_MOD_MORPH(NAME, mods = <(MOD_L##MOD | MOD_R##MOD)>;                      \
bindings = <BINDING1>, <BINDING2>;)

// Tap: comma | Shift + tap: semicolon | Ctrl + shift + tap: <.
SIMPLE_MORPH(comma_morph, SFT, &kp COMMA, &comma_inner_morph)
SIMPLE_MORPH(comma_inner_morph, CTL, &kp SEMICOLON, &kp LESS_THAN)

// Tap: dot | Shift + tap: colon | Ctrl + shift + tap: >.
SIMPLE_MORPH(dot_morph, SFT, &kp DOT, &dot_inner_morph)
SIMPLE_MORPH(dot_inner_morph, CTL, &kp COLON, &kp GREATER_THAN)

// Tap: qmark | Shift + tap: excl.
SIMPLE_MORPH(qexcl, SFT, &kp QMARK, &kp EXCL)

// Tap: left/right parenthesis | Shft + tap: less-than/greater-than.
SIMPLE_MORPH(lpar_lt, SFT, &kp LPAR, &kp LT)
SIMPLE_MORPH(rpar_gt, SFT, &kp RPAR, &kp GT)

// Tap: space | Shift + tap: dot -> space -> sticky shift | Hold: nav layer.
ZMK_HOLD_TAP(lt_spc, bindings = <&mo>, <&spc_morph>; flavor = "balanced";
             tapping-term-ms = <200>; quick-tap-ms = <QUICK_TAP_MS>;)
SIMPLE_MORPH(spc_morph, SFT, &kp SPACE, &dot_spc)
ZMK_MACRO(dot_spc, bindings = <&kp DOT &kp SPACE &sk LSHFT>; wait-ms = <0>;
          tap-ms = <5>;)

// Tap: mouse move {direction} | Shift + tap: fast mouse move {direction}
SIMPLE_MORPH(mouse_up, SFT, U_MS_U, U_MS_FU)
SIMPLE_MORPH(mouse_down, SFT, U_MS_D, U_MS_FD)
SIMPLE_MORPH(mouse_left, SFT, U_MS_L, U_MS_FL)
SIMPLE_MORPH(mouse_right, SFT, U_MS_R, U_MS_FR)

/ {
    behaviors {
        repeat: alt_repeat {
            compatible = "zmk,behavior-adaptive-key";
            #binding-cells = <0>;
            bindings = <&key_repeat>;
            akt_a_repeat { trigger-keys = <A>; max-prior-idle-ms = <1200>; bindings = <&kp N &kp D>;};                        // A @    = ND
            akt_i_repeat { trigger-keys = <I>; max-prior-idle-ms = <1200>; bindings = <&kp N &kp G>;};                        // I @    = NG
            akt_y_repeat { trigger-keys = <Y>; max-prior-idle-ms = <1200>; bindings = <&kp O &kp U>;};                        // Y @    = OU
            akt_n_repeat { trigger-keys = <N>; max-prior-idle-ms = <1200>; bindings = <&kp F>;};                              // Y @    = OU
            akt_b_repeat { trigger-keys = <B>; max-prior-idle-ms = <1200>; 
                           bindings = <&kp E &kp C &kp A &kp U &kp S &kp E>;};                                                // B @    = ECAUSE
            akt_w_repeat { trigger-keys = <W>; max-prior-idle-ms = <1200>; bindings = <&kp O &kp U &kp L &kp D>;};            // W @    = OULD
            akt_comma_repeat { trigger-keys = <COMMA>; max-prior-idle-ms = <1200>; bindings = <&kp SPACE &kp A &kp N &kp D>;};// , @    = ⎵AND
            akt_wspc_repeat { trigger-keys = <SPACE>; max-prior-idle-ms = <1200>; bindings = <&kp F &kp O &kp R>;};           // wspc @ = FOR
        };
        magic: magic_key {
            compatible = "zmk,behavior-adaptive-key";
            #binding-cells = <0>;
            bindings = <&kp N>;
            akt_a_magic { trigger-keys = <A>; max-prior-idle-ms = <1200>; bindings = <&kp O>;};                               // A *    = O
            akt_c_magic { trigger-keys = <C>; max-prior-idle-ms = <1200>; bindings = <&kp Y>;};                               // C *    = Y
            akt_d_magic { trigger-keys = <D>; max-prior-idle-ms = <1200>; bindings = <&kp Y>;};                               // D *    = Y
            akt_e_magic { trigger-keys = <E>; max-prior-idle-ms = <1200>; bindings = <&kp U>;};                               // E *    = U
            akt_g_magic { trigger-keys = <G>; max-prior-idle-ms = <1200>; bindings = <&kp Y>;};                               // G *    = Y
            akt_i_magic { trigger-keys = <I>; max-prior-idle-ms = <1200>; bindings = <&kp O &kp N>;};                         // I *    = ON
            akt_j_magic { trigger-keys = <J>; max-prior-idle-ms = <1200>; bindings = <&kp U &kp S &kp T>;};                   // J *    = UST
            akt_k_magic { trigger-keys = <K>; max-prior-idle-ms = <1200>; bindings = <&kp S>;};                               // K *    = S
            akt_l_magic { trigger-keys = <L>; max-prior-idle-ms = <1200>; bindings = <&kp K>;};                               // L *    = K
            akt_m_magic { trigger-keys = <M>; max-prior-idle-ms = <1200>; bindings = <&kp E &kp N &kp T>;};                   // M *    = ENT
            akt_n_magic { trigger-keys = <N>; max-prior-idle-ms = <1200>; bindings = <&kp I &kp O &kp N>;};                   // N *    = ION
            akt_o_magic { trigger-keys = <O>; max-prior-idle-ms = <1200>; bindings = <&kp A>;};                               // O *    = A
            akt_p_magic { trigger-keys = <P>; max-prior-idle-ms = <1200>; bindings = <&kp Y>;};                               // P *    = Y
            akt_q_magic { trigger-keys = <Q>; max-prior-idle-ms = <1200>; bindings = <&kp U &kp E &kp N>;};                   // Q *    = UEN
            akt_r_magic { trigger-keys = <R>; max-prior-idle-ms = <1200>; bindings = <&kp L>;};                               // R *    = L
            akt_s_magic { trigger-keys = <S>; max-prior-idle-ms = <1200>; bindings = <&kp K>;};                               // S *    = K
            akt_t_magic { trigger-keys = <T>; max-prior-idle-ms = <1200>; bindings = <&kp M &kp E &kp N &kp T>;};             // T *    = MENT
            akt_u_magic { trigger-keys = <U>; max-prior-idle-ms = <1200>; bindings = <&kp E>;};                               // U *    = E
            akt_y_magic { trigger-keys = <Y>; max-prior-idle-ms = <1200>; bindings = <&kp P>;};                               // Y *    = P
            akt_comma_magic { trigger-keys = <COMMA>; max-prior-idle-ms = <1200>; bindings = <&kp SPACE &kp B &kp U &kp T>;}; // , *    = ⎵BUT
            akt_dot_magic { trigger-keys = <DOT>; max-prior-idle-ms = <1200>; bindings = <&kp DOT &kp SLASH>;};               // . *    = ./
            akt_wspc_magic { trigger-keys = <SPACE>; max-prior-idle-ms = <1200>; bindings = <&kp T &kp H &kp E>;};            // wspc * = THE
        };
    };
};

/ {
    keymap {
        compatible = "zmk,keymap";

        base { // 0 Magic Sturdy
            bindings = <
// ╭────────────────┬────────────────┬────────────────┬────────────────┬────────────────┬────────────────╮    ╭────────────────┬────────────────┬────────────────┬───────────────┬────────────────┬────────────────╮
     &kp TAB          &kp V            &kp M            &kp L            &kp C            &kp P                 &kp B            &magic           &kp U            &kp O           &kp Q            &kp BSPC
// ├────────────────┼────────────────┼────────────────┼────────────────┼────────────────┼────────────────┤    ├────────────────┼────────────────┼────────────────┼───────────────┼────────────────┼────────────────┤
     &kp ESC          &hml LCTRL S     &hml LALT T      &hml LGUI R      &hml LSHFT D     &kp Y                 &kp F            &hmr RSHFT N     &hmr RGUI E      &hmr RALT A     &hmr RCTRL I     &kp RET
// ├────────────────┼────────────────┼────────────────┼────────────────┼────────────────┼────────────────┤    ├────────────────┼────────────────┼────────────────┼───────────────┼────────────────┼────────────────┤
     &sk HYPER        &kp X            &kp K            &kp J            &lt SYM G        &kp W                 &kp Z            &lt SYM H        &comma_morph     &dot_morph      &kp SQT          &kp SLASH
// ╰────────────────┴────────────────┴────────────────┴────────────────┼────────────────┼────────────────┤    ├────────────────┼────────────────┼────────────────┼───────────────┼────────────────┼────────────────╯
                                                        &tog FN          &tog SYS         &repeat               &lt_spc NAV 0    &tog NAV         SMART_NUM
//                                                    ╰────────────────┴────────────────┴────────────────╯    ╰────────────────┴────────────────┴────────────────╯
            >;
        };
        symbol { // 1
            bindings = <
// ╭────────────────┬────────────────┬────────────────┬────────────────┬────────────────┬────────────────╮    ╭────────────────┬────────────────┬────────────────┬───────────────┬────────────────┬────────────────╮
     &kp LC(A)        &kp GRAVE        &kp LT           &kp GT           &kp MINUS        &kp PIPE              &kp CARET        &kp RBRC         &kp LBRC         &kp DOLLAR      ___              ___
// ├────────────────┼────────────────┼────────────────┼────────────────┼────────────────┼────────────────┤    ├────────────────┼────────────────┼────────────────┼───────────────┼────────────────┼────────────────┤
     ___              &kp EXCL         &kp STAR         &kp SLASH        &kp EQUAL        &kp AMPS              &kp HASH         &kp RPAR         &kp LPAR         &kp SEMI        &kp DQT          ___
// ├────────────────┼────────────────┼────────────────┼────────────────┼────────────────┼────────────────┤    ├────────────────┼────────────────┼────────────────┼───────────────┼────────────────┼────────────────┤
     ___              &kp TILDE        &kp PLUS         &kp LBKT         &kp RBKT         &kp PRCNT             &kp AT           &kp COLON        &kp COMMA        &kp DOT         &kp SQT          ___
// ╰────────────────┴────────────────┴────────────────┴────────────────┼────────────────┼────────────────┤    ├────────────────┼────────────────┼────────────────┼───────────────┼────────────────┼────────────────╯
                                                        &tog SYM         ___              ___                   ___              ___              ___
//                                                    ╰────────────────┴────────────────┴────────────────╯    ╰────────────────┴────────────────┴────────────────╯
            >;
        };
        navigation { // 2
            bindings = <
// ╭────────────────┬────────────────┬────────────────┬────────────────┬────────────────┬────────────────╮    ╭────────────────┬────────────────┬────────────────┬───────────────┬────────────────┬────────────────╮
     ___              ___              ___              ___              ___              ___                   ___              ___              ___              ___             ___              ___
// ├────────────────┼────────────────┼────────────────┼────────────────┼────────────────┼────────────────┤    ├────────────────┼────────────────┼────────────────┼───────────────┼────────────────┼────────────────┤
     ___              &sk LCTRL        &sk LALT         &sk LGUI         &sk LSHFT        ___                   ___              NAV_LEFT         NAV_DOWN         NAV_UP          NAV_RIGHT        ___
// ├────────────────┼────────────────┼────────────────┼────────────────┼────────────────┼────────────────┤    ├────────────────┼────────────────┼────────────────┼───────────────┼────────────────┼────────────────┤
     ___              ___              ___              ___              ___              ___                   ___              ___              ___              ___             ___              ___
// ╰────────────────┴────────────────┴────────────────┴────────────────┼────────────────┼────────────────┤    ├────────────────┼────────────────┼────────────────┼───────────────┼────────────────┼────────────────╯
                                                        &tog NAV         ___              ___                   ___              ___              ___
//                                                    ╰────────────────┴────────────────┴────────────────╯    ╰────────────────┴────────────────┴────────────────╯
            >;
        };

        function { // 3
            bindings = <
// ╭────────────────┬────────────────┬────────────────┬────────────────┬────────────────┬────────────────╮    ╭────────────────┬────────────────┬────────────────┬───────────────┬────────────────┬────────────────╮
     &kp F15          &kp F12          &kp F7           &kp F8           &kp F9           ___                   ___              ___              ___              ___             ___              ___
// ├────────────────┼────────────────┼────────────────┼────────────────┼────────────────┼────────────────┤    ├────────────────┼────────────────┼────────────────┼───────────────┼────────────────┼────────────────┤
     &kp F14          &hml LCTRL F11   &hml LALT F4     &hml LGUI F5     &hml LSHFT F6    ___                   ___              NAV_LEFT         NAV_DOWN         NAV_UP          NAV_RIGHT        ___
// ├────────────────┼────────────────┼────────────────┼────────────────┼────────────────┼────────────────┤    ├────────────────┼────────────────┼────────────────┼───────────────┼────────────────┼────────────────┤
     ___              &kp F10          &kp F1           &kp F2           &kp F3           ___                   ___              ___              ___              ___             ___              ___
// ╰────────────────┴────────────────┴────────────────┴────────────────┼────────────────┼────────────────┤    ├────────────────┼────────────────┼────────────────┼───────────────┼────────────────┼────────────────╯
                                                        &tog FN          ___              ___                   ___              ___              ___
//                                                    ╰────────────────┴────────────────┴────────────────╯    ╰────────────────┴────────────────┴────────────────╯
            >;
        };

        number { // 4
            bindings = <
// ╭────────────────┬────────────────┬────────────────┬────────────────┬────────────────┬────────────────╮    ╭────────────────┬────────────────┬────────────────┬───────────────┬────────────────┬────────────────╮
     ___              &kp SLASH        &kp N7           &kp N8           &kp N9           &kp STAR              ___              ___              ___              ___             ___              ___
// ├────────────────┼────────────────┼────────────────┼────────────────┼────────────────┼────────────────┤    ├────────────────┼────────────────┼────────────────┼───────────────┼────────────────┼────────────────┤
     ___              &hml LCTRL N0    &hml LALT N4     &hml LGUI N5     &hml LSHFT N6    &kp PLUS              ___              &sk RSHIFT       &sk RGUI         &sk LALT        &sk RCTRL        ___
// ├────────────────┼────────────────┼────────────────┼────────────────┼────────────────┼────────────────┤    ├────────────────┼────────────────┼────────────────┼───────────────┼────────────────┼────────────────┤
     ___              &kp PRCNT        &kp N1           &kp N2           &kp N3           &kp MINUS             ___              ___              ___              ___             ___              ___
// ╰────────────────┴────────────────┴────────────────┴────────────────┼────────────────┼────────────────┤    ├────────────────┼────────────────┼────────────────┼───────────────┼────────────────┼────────────────╯
                                                        &tog NUM         ___              ___                   &kp EQUAL        ___              ___
//                                                    ╰────────────────┴────────────────┴────────────────╯    ╰────────────────┴────────────────┴────────────────╯
            >;
        };

        system { // 5
            bindings = <
// ╭────────────────┬────────────────┬────────────────┬────────────────┬────────────────┬────────────────╮    ╭────────────────┬────────────────┬────────────────┬───────────────┬────────────────┬────────────────╮
     ___              ___              ___              ___              ___              ___                   ___              &kp C_MUTE       &kp C_VOL_DN     &kp C_VOL_UP    &kp C_PP         &kp C_NEXT
// ├────────────────┼────────────────┼────────────────┼────────────────┼────────────────┼────────────────┤    ├────────────────┼────────────────┼────────────────┼───────────────┼────────────────┼────────────────┤
     ___              &sk LCTRL        &sk LALT         &sk LGUI         &sk LSHFT        ___                   ___              &mouse_left      &mouse_down      &mouse_up       &mouse_right     &kp C_PREV
// ├────────────────┼────────────────┼────────────────┼────────────────┼────────────────┼────────────────┤    ├────────────────┼────────────────┼────────────────┼───────────────┼────────────────┼────────────────┤
     ___              ___              ___              ___              ___              ___                   U_MS_RC          U_MS_LC          &kp F14          &kp F15         ___              ___
// ╰────────────────┴────────────────┴────────────────┴────────────────┼────────────────┼────────────────┤    ├────────────────┼────────────────┼────────────────┼───────────────┼────────────────┼────────────────╯
                                                        &tog SYS         ___              ___                   ___              ___              ___
//                                                    ╰────────────────┴────────────────┴────────────────╯    ╰────────────────┴────────────────┴────────────────╯
            >;
        };
    };
};
